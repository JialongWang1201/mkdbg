/**
 ******************************************************************************
 * @file      LinkerScript.ld
 * @author    Auto-generated by STM32CubeIDE
 *  Abstract    : Linker script for NUCLEO-F446RE Board embedding STM32F446RETx Device from stm32f4 series
 *                      512Kbytes FLASH
 *                      128Kbytes RAM
 *
 *            Set heap size, stack size and stack location according
 *            to application requirements.
 *
 *            Set memory bank area and size if external memory is used
 ******************************************************************************
 * @attention
 *
 * <h2><center>&copy; Copyright (c) 2020 STMicroelectronics.
 * All rights reserved.</center></h2>
 *
 * This software component is licensed by ST under BSD 3-Clause license,
 * the "License"; You may not use this file except in compliance with the
 * License. You may obtain a copy of the License at:
 *                        opensource.org/licenses/BSD-3-Clause
 *
 ******************************************************************************
 */

/* Entry Point */
ENTRY(Reset_Handler)

/* Highest address of the user mode stack */
_estack = ORIGIN(PRIV_RAM) + LENGTH(PRIV_RAM);	/* end of total RAM */

_Min_Heap_Size = 0x200 ;	/* required amount of heap  */
_Min_Stack_Size = 0x800 ;	/* required amount of stack */

__FLASH_segment_start__ = ORIGIN(FLASH);
__FLASH_segment_end__ = ORIGIN(FLASH) + LENGTH(FLASH);
__SRAM_segment_start__ = ORIGIN(RAM);
__SRAM_segment_end__ = ORIGIN(RAM) + LENGTH(RAM);

/* Memories definition */
MEMORY
{
  RAM      (xrw)    : ORIGIN = 0x20000000,   LENGTH = 64K
  PRIV_RAM (xrw)    : ORIGIN = 0x20010000,   LENGTH = 64K
  FLASH    (rx)    : ORIGIN = 0x8000000,    LENGTH = 512K
}

PHDRS
{
  flash PT_LOAD FLAGS(5); /* R_X */
  ram   PT_LOAD FLAGS(6); /* RW_ */
}

/* Sections */
SECTIONS
{
  /* The startup code into "FLASH" Rom type memory */
  .isr_vector :
  {
    . = ALIGN(4);
    KEEP(*(.isr_vector)) /* Startup code */
    . = ALIGN(4);
  } >FLASH :flash

  /* Privileged code at the start of flash (first 32KB block). */
  .privileged_functions :
  {
    . = ALIGN(4);
    __privileged_functions_start__ = .;
    *(privileged_functions)
    *(privileged_functions*)
    *(.privileged_functions)
    *(.privileged_functions*)
    __privileged_functions_end__ = .;
    . = ALIGN(4);
  } >FLASH :flash

  /* The program code and other data into "FLASH" Rom type memory */
  .text 0x08008000 :
  {
    . = ALIGN(4);
    __syscalls_flash_start__ = .;
    *(freertos_system_calls)
    *(freertos_system_calls*)
    *(.freertos_system_calls)
    *(.freertos_system_calls*)
    __syscalls_flash_end__ = .;

    . = ALIGN(4);
    *(.text)           /* .text sections (code) */
    *(.text*)          /* .text* sections (code) */
    *(.glue_7)         /* glue arm to thumb code */
    *(.glue_7t)        /* glue thumb to arm code */
    *(.eh_frame)

    KEEP (*(.init))
    KEEP (*(.fini))

    . = ALIGN(4);
    _etext = .;        /* define a global symbols at end of code */
  } >FLASH :flash

  /* Constant data into "FLASH" Rom type memory */
  .rodata :
  {
    . = ALIGN(4);
    *(.rodata)         /* .rodata sections (constants, strings, etc.) */
    *(.rodata*)        /* .rodata* sections (constants, strings, etc.) */
    . = ALIGN(4);
  } >FLASH :flash

  .ARM.extab   : {
    . = ALIGN(4);
    *(.ARM.extab* .gnu.linkonce.armextab.*)
    . = ALIGN(4);
  } >FLASH :flash

  .ARM : {
    . = ALIGN(4);
    __exidx_start = .;
    *(.ARM.exidx*)
    __exidx_end = .;
    . = ALIGN(4);
  } >FLASH :flash


  .preinit_array     :
  {
    . = ALIGN(4);
    PROVIDE_HIDDEN (__preinit_array_start = .);
    KEEP (*(.preinit_array*))
    PROVIDE_HIDDEN (__preinit_array_end = .);
    . = ALIGN(4);
  } >FLASH :flash

  .init_array :
  {
    . = ALIGN(4);
    PROVIDE_HIDDEN (__init_array_start = .);
    KEEP (*(SORT(.init_array.*)))
    KEEP (*(.init_array*))
    PROVIDE_HIDDEN (__init_array_end = .);
    . = ALIGN(4);
  } >FLASH :flash

  .fini_array :
  {
    . = ALIGN(4);
    PROVIDE_HIDDEN (__fini_array_start = .);
    KEEP (*(SORT(.fini_array.*)))
    KEEP (*(.fini_array*))
    PROVIDE_HIDDEN (__fini_array_end = .);
    . = ALIGN(4);
  } >FLASH :flash

  /* Used by the startup to initialize data */
  _sidata = LOADADDR(.data);

  /* Initialized data sections into "RAM" Ram type memory */
  .data :
  {
    . = ALIGN(4);
    _sdata = .;        /* create a global symbol at data start */
    *(.data)           /* .data sections */
    *(.data*)          /* .data* sections */
    *(.RamFunc)        /* .RamFunc sections */
    *(.RamFunc*)       /* .RamFunc* sections */

    . = ALIGN(4);
    _edata = .;        /* define a global symbol at data end */

  } >RAM AT> FLASH :ram

  /* Used by the startup to initialize privileged data */
  _siprivdata = LOADADDR(.privileged_data);

  .privileged_data :
  {
    . = ALIGN(4);
    _sprivdata = .;
    __privileged_data_start__ = .;
    *(privileged_data)
    *(privileged_data*)
    *(.privileged_data)
    *(.privileged_data*)
    __privileged_data_end__ = .;
    _eprivdata = .;
    . = ALIGN(4);
  } >PRIV_RAM AT> FLASH :ram

  .shared_data (NOLOAD) :
  {
    . = ALIGN(256);
    *(.shared_data)
    . = ALIGN(256);
  } >RAM :ram

  .shared_ctrl (NOLOAD) :
  {
    . = ALIGN(64);
    *(.shared_ctrl)
    . = ALIGN(64);
  } >RAM :ram

  .shared_stats (NOLOAD) :
  {
    . = ALIGN(4096);
    *(.shared_stats)
    . = ALIGN(4096);
  } >RAM :ram

  .fault_retained (NOLOAD) :
  {
    . = ALIGN(64);
    *(.fault_retained)
    . = ALIGN(64);
  } >PRIV_RAM :ram

  /* Uninitialized data section into "RAM" Ram type memory */
  . = ALIGN(4);
  .bss :
  {
    /* This is used by the startup in order to initialize the .bss section */
    _sbss = .;         /* define a global symbol at bss start */
    __bss_start__ = _sbss;
    . = ALIGN(4);
    *(.bss)
    *(.bss*)
    *(COMMON)

    . = ALIGN(4);
    _ebss = .;         /* define a global symbol at bss end */
    __bss_end__ = _ebss;
  } >RAM :ram

  /* User_heap_stack section, used to check that there is enough "RAM" Ram  type memory left */
  ._user_heap_stack :
  {
    . = ALIGN(8);
    PROVIDE ( end = . );
    PROVIDE ( _end = . );
    . = . + _Min_Heap_Size;
    . = . + _Min_Stack_Size;
    . = ALIGN(8);
  } >RAM :ram


 

  .ARM.attributes 0 : { *(.ARM.attributes) }
}
